// klor konrad -- same board as the standard klor, but it wants a plain QWERTY
// layer where the standard one has gaming. Published as config/klor.keymap.
#define HAS_QWERTY
#include "layout_klor.dtsi"
#include "keymap_core.dtsi"
